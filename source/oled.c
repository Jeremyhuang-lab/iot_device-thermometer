#ifndef _OLED_C_
#define _OLED_C_
/*********************************************************************************************************************/
#include "include/Public.h"
#include "include/oledtab.h"
/*********************************************************************************************************************/

#if OLED_TEST 
unsigned char code show[]=
{
0x00,0x00,0x00,0x06,0x0A,0xFE,0x0A,0xC6,0x00,0xE0,0x00,0xF0,0x00,0xF8,0x00,0x00,
0x00,0x00,0x00,0x00,0xFE,0x7D,0xBB,0xC7,0xEF,0xEF,0xEF,0xEF,0xEF,0xEF,0xEF,0xC7,
0xBB,0x7D,0xFE,0x00,0x00,0x00,0x00,0x00,0x00,0x00,0x00,0x00,0x00,0x00,0x00,0x00,
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0x20,0x5F,0x80,0x00,0x1F,0x20,0x40,0x40,0x40,0x50,0x20,0x5F,0x80,0x00,0x00,0x00,
};

void Fill_Picture(unsigned char Fill_Data)
{
    unsigned char m,n;
    for(m=0;m<8;m++)
    {
        Write_IIC_Command(0xb0+m);
        Write_IIC_Command(0x00);
        Write_IIC_Command(0x10);
        for(n=0;n<132;n++)
        {
            Write_IIC_Data(Fill_Data);
           
        }
    }
}
void Picture(void)
{
      unsigned char x,y;
      unsigned int i=0;
      for(y=0;y<8;y++)
        {
          Write_IIC_Command(0xb0+y);
          Write_IIC_Command(0x0);
          Write_IIC_Command(0x10);
          for(x=0;x<132;x++)
            {
              Write_IIC_Data(show[i++]);
            }
        }
}

#endif 

void Write_IIC_Command(unsigned char Command)
{
    IIC_Start();
    IIC_Send_Byte(OLED_ADDR|Write_CMD);
    IIC_Wait_Ack();
    IIC_Send_Byte(0x00);
    IIC_Wait_Ack();
    IIC_Send_Byte(Command);
    IIC_Wait_Ack();
    IIC_Stop();
}

void Write_IIC_Data(unsigned char WriteData)
{
    IIC_Start();
    IIC_Send_Byte(OLED_ADDR|Write_CMD);
    IIC_Wait_Ack();
    IIC_Send_Byte(0x40);
    IIC_Wait_Ack();
    IIC_Send_Byte(WriteData);
    IIC_Wait_Ack();
    IIC_Stop();   
}


void OLED_Init(void)
{
	Write_IIC_Command(0xAE);   //display off
	Write_IIC_Command(0x20);	//Set Memory Addressing Mode	
	Write_IIC_Command(0x10);	//00,Horizontal Addressing Mode;01,Vertical Addressing Mode;10,Page Addressing Mode (RESET);11,Invalid
	Write_IIC_Command(0xb0);	//Set Page Start Address for Page Addressing Mode,0-7
	Write_IIC_Command(0xc8);	//Set COM Output Scan Direction
	Write_IIC_Command(0x00);//---set low column address
	Write_IIC_Command(0x10);//---set high column address
	Write_IIC_Command(0x40);//--set start line address
	Write_IIC_Command(0x81);//--set contrast control register
	Write_IIC_Command(0xdf);
	Write_IIC_Command(0xa1);//--set segment re-map 0 to 127
	Write_IIC_Command(0xa6);//--set normal display
	Write_IIC_Command(0xa8);//--set multiplex ratio(1 to 64)
	Write_IIC_Command(0x3F);//
	Write_IIC_Command(0xa4);//0xa4,Output follows RAM content;0xa5,Output ignores RAM content
	Write_IIC_Command(0xd3);//-set display offset
	Write_IIC_Command(0x00);//-not offset
	Write_IIC_Command(0xd5);//--set display clock divide ratio/oscillator frequency
	Write_IIC_Command(0xf0);//--set divide ratio
	Write_IIC_Command(0xd9);//--set pre-charge period
	Write_IIC_Command(0x22); //
	Write_IIC_Command(0xda);//--set com pins hardware configuration
	Write_IIC_Command(0x12);
	Write_IIC_Command(0xdb);//--set vcomh
	Write_IIC_Command(0x20);//0x20,0.77xVcc
	Write_IIC_Command(0x8d);//--set DC-DC enable
	Write_IIC_Command(0x14);//
	Write_IIC_Command(0xaf);//--turn on oled panel 
}

/***********************************************************************************
函数名：  OLED_Fill
功能说明：OLED全屏填充
输入参数：None
返回值：  None						
***********************************************************************************/
void OLED_Fill(unsigned char fill_Data)
{
	unsigned char x,y;
	unsigned int i=0;
	for(y=0;y<8;y++)
	{
		Write_IIC_Command(0xb0+y);     //设置页地址（0~7）
		Write_IIC_Command(0x00);       //设置显示位置—列低地址
		Write_IIC_Command(0x10);       //设置显示位置—列高地址
		for(x=0;x<132;x++)             //写0x00到屏幕寄存器上   
		{
		   Write_IIC_Data(fill_Data);
		}
	}
}
/***********************************************************************************
函数名：  OLED_Clear
功能说明：OLED清屏
输入参数：None
返回值：  None						
***********************************************************************************/
void OLED_Clear(void)
{
	OLED_Fill(0x00);
}
/***********************************************************************************
函数名：  OLED_ON
功能说明：OLED唤醒
输入参数：None
返回值：  None						
***********************************************************************************/
void OLED_ON(void)
{
	Write_IIC_Command(0x8D);  //设置电荷泵
	Write_IIC_Command(0x14);  //开启电荷泵
	Write_IIC_Command(0xAF);  //OLED唤醒
	
}

/***********************************************************************************
函数名：  OLED_OFF
功能说明：OLED休眠
输入参数：None
返回值：  None						
***********************************************************************************/
void OLED_OFF(void)
{
	Write_IIC_Command(0x8D);  //设置电荷泵
	Write_IIC_Command(0x10);  //关闭电荷泵
	Write_IIC_Command(0xAE);  //OLED休眠
}

/***********************************************************************************
函数名：  OLED_SetPos
功能说明：设置开始的光标位置
输入参数：x，y：位置
返回值：  None						
***********************************************************************************/
void OLED_SetPos(unsigned char x, unsigned char y)
{
	Write_IIC_Command(0xb0+y);                //设置页地址（0~7）
	Write_IIC_Command(((x&0xf0)>>4)|0x10);    //写入列低地址
	Write_IIC_Command(x&0x0f);                //写入列高地址
}
/***********************************************************************************
函数名：  OLED_ShowChar
功能说明：显示6*8或8*16一个标准ASCII字符串
输入参数：x：起始列
					 y：起始页，TextSize = 16占两页；TextSize = 8占1页
					 ch：字符
返回值：  None						
***********************************************************************************/
void OLED_ShowChar(unsigned char x, unsigned char y, unsigned char ch, unsigned char TextSize)
{
	unsigned char c = 0,i=0;
	c = ch - ' ' ;  //得到偏移后的值	
	if(x>Max_Column-1)
    {x=0;y=y+2;}
	if(TextSize==16)
	{
		OLED_SetPos(x,y);
		for(i=0;i<8;i++)
			Write_IIC_Data(F8X16[c*16+i]);
		OLED_SetPos(x,y+1);
		for(i=0;i<8;i++)
			Write_IIC_Data(F8X16[c*16+i+8]);		
	}
	else
	{
		OLED_SetPos(x,y);
		for(i=0;i<6;i++)
		Write_IIC_Data(F6x8[c][i]);
	}
}
/***********************************************************************************
函数名：  OLED_ShowStr
功能说明：显示字符串
输入参数：x：起始列
					 y：起始页
					 *ch：第一个字符首地址
           TextSize：字符大小(1:6*8 ; 2:8*16)
返回值：  None						
***********************************************************************************/
void OLED_ShowStr(unsigned char x, unsigned char y, unsigned char *ch, unsigned char TextSize)
{
	unsigned char c = 0,i = 0,j = 0;
	while(ch[j] != '\0')                   //如果不是最后一个字符
	{
		OLED_ShowChar(x,y,ch[j],TextSize); //显示字符
		if(TextSize==8)
		{
			x += 6;//列数加6 ，一个字符的列数占6
			if(x > 126)  //如果x超过128，切换页，从该页的第一列显示
			{
				x = 0;  
				y += 2;  
			}  		
			j++;  //下一个字符
		}
		else
		{
			x += 8;//列数加8 ，一个字符的列数占8
			if(x > 120)  //如果x超过128，切换页，从该页的第一列显示
			{
				x = 0;  
				y += 2;  
			}  		
			j++;  //下一个字符
		}
	}
}

/*****************************************************************************
函数名称 : OLED_Pow
功能描述 : 计算m^n
输入参数 : m：输入的一个数   n：输入数的次方
返回值   : result：一个数的n次方
*****************************************************************************/ 
unsigned long int OLED_Pow(unsigned char m,unsigned char n)
{
	unsigned char result=1;	 
	while(n--)result*=m;    
	return result;
}		

/***********************************************************************************
函数名：  OLED_ShowNum
功能说明：OLED显示2个数字
输入参数： x,y -- 起始点坐标(x:0~127, y:0~7); ch[] -- 要显示的字符串; TextSize -- 字符大小(1:6*8 ; 2:8*16)
返回值：  None						
***********************************************************************************/
void OLED_ShowNum(unsigned char x, unsigned char y, unsigned long int num, unsigned char len, unsigned char TextSize)
{
	unsigned int i,t,temp;  //定义变量
	unsigned int enshow=0;		//定义变量
	if(TextSize==8)
		i = 6;
	else
		i = 8;
	if(num<0)  //要显示的数小于0
	{
		num = -num;
		OLED_ShowChar(x,y,'-',TextSize);
		for(t=0;t<len;t++)
		{
			temp=(num/OLED_Pow(10,len-t-1))%10;//取出输入数的每个位，由高到低
			if(enshow==0&&t<(len-1)) //enshow：是否为第一个数；t<(len-1)：判断是否为最后一个数
			{
				if(temp==0) //如果该数为0 
				{
					OLED_ShowChar(x+i*(t+1),y,' ',TextSize);//显示 0 ；x+(size2/2)*t根据字体大小偏移的列数（8）
					continue; //跳过剩下语句，继续重复循环（避免重复显示）
				}else enshow=1; 
			}
			OLED_ShowChar(x+i*(t+1),y,temp+'0',TextSize); //显示一个位；x+(size2/2)*t根据字体大小偏移的列数（8）
		}
	}
	else  //要显示的数大于0
	{
		for(t=0;t<len;t++)
		{
			temp=(num/OLED_Pow(10,len-t-1))%10;//取出输入数的每个位，由高到低
			if(enshow==0&&t<(len-1)) //enshow：是否为第一个数；t<(len-1)：判断是否为最后一个数
			{
				if(temp==0) //如果该数为0 
				{
					OLED_ShowChar(x+i*t,y,' ',TextSize);//显示 0 ；x+(size2/2)*t根据字体大小偏移的列数（8）
					continue; //跳过剩下语句，继续重复循环（避免重复显示）
				}else enshow=1; 
		 	}
			OLED_ShowChar(x+i*t,y,temp+'0',TextSize); //显示一个位；x+(size2/2)*t根据字体大小偏移的列数（8）
		}
	}
}

void OLED_Show_Float_Number(unsigned char x,unsigned char y,float num,unsigned char TextSize)
{
	unsigned char zheng_len = 0, xiao_len = 0, polarity_flag;
	int zheng = 0, xiao = 0;
	if (num > 0)
		polarity_flag = 1;
	else
	{
		polarity_flag = 0;
		num = -num;
	}
	zheng = (int) num;
	xiao = ((num - zheng) * 100) / 1;   //显示小数点后两位
	while (zheng)    //计算整数部分位数
	{
		zheng_len++;
		zheng /= 10;
	}
	xiao_len = 2;
	zheng = (int) num; //在计算整数部分数值时，原赋值被篡改，这里重新赋值
	if (polarity_flag)
	{
		if (TextSize == 16)
		{
			OLED_ShowNum(x, y, zheng, zheng_len, TextSize);
			OLED_ShowChar(x + zheng_len * 8, y, '.', TextSize);
			OLED_ShowNum(x + (zheng_len + 1) * 8, y, xiao, xiao_len, TextSize);
		}
		else
		{
			OLED_ShowNum(x, y, zheng, zheng_len,TextSize);
			OLED_ShowChar(x + zheng_len * 6, y, '.', TextSize);
			OLED_ShowNum(x + (zheng_len + 1) * 6, y, xiao, xiao_len, TextSize);
		}
	}
	else
	{
		OLED_ShowChar(x, y, '-', TextSize);
		if (TextSize == 16)
		{
			OLED_ShowNum(x + 8, y, zheng, zheng_len, TextSize);
			OLED_ShowChar(x + (zheng_len + 1) * 8, y, '.', TextSize);
			OLED_ShowNum(x + (zheng_len + 2) * 8, y, xiao, xiao_len, TextSize);
		}
		else
		{
			OLED_ShowNum(x + 6, y, zheng, zheng_len, TextSize);
			OLED_ShowChar(x + (zheng_len + 1) * 6, y, '.', TextSize);
			OLED_ShowNum(x + (zheng_len + 2) * 6, y, xiao, xiao_len, TextSize);
		}
	}
}
/***********************************************************************************
函数名：  OLED_ShowCN
功能说明：显示中文
输入参数：x：起始列，一个字占16列 y：起始页，一个字占两页 N：字体的序列号
返回值：  None						
***********************************************************************************/
void OLED_ShowCN(unsigned char x, unsigned char y, unsigned char N)
{
	unsigned char i ;
	unsigned int adder = 0;
	OLED_SetPos(x , y);
	for(i = 0;i < 16;i++)
	{
		Write_IIC_Data(CH[2*N][i]);
		adder += 1;
	}
	OLED_SetPos(x,y + 1);
	for(i = 0;i< 16;i++)
	{
		Write_IIC_Data(CH[2*N+1][i]);
		adder += 1;
	}
}
/***********************************************************************************
函数名：  OLED_DrawBMP
功能说明：显示图片
输入参数 : x0：起始列地址（0~127）
					 y0：起始页地址（0~7）
					 x1：终止列地址（1~128）
					 y1：终止页地址（1~8）
				   BMP[]：存放图片代码的数组
返回值：  None						
***********************************************************************************/
void OLED_DrawBMP(unsigned char x0,unsigned char y0,unsigned char x1,unsigned char y1,unsigned char BMP[])
{
	unsigned int j=0;
	unsigned char x,y;

	if(y1%8==0)
		y = y1/8;
	else
		y = y1/8 + 1;
	for(y=y0;y<y1;y++)
	{
		OLED_SetPos(x0,y);
	    for(x=x0;x<x1;x++)
		{
			Write_IIC_Data(BMP[j++]);
		}
	}
}
/***********************************************************************************
函数名：  OLED_Temp_Humi_Display
功能说明：显示图片
输入参数 : temp：温度系数
		   Humi：湿度系数 			
返回值：  None						
***********************************************************************************/
void OLED_Temp_Humi_Display(float temp,float Humi)
{
	int i = 0;
//	OLED_Clear();  //清屏
    for(i=0;i<7;i++)
	{
		OLED_ShowCN(i*18,0,i);			
	}
	OLED_ShowCN(6,3,7);	
	OLED_ShowCN(24,3,9);
    OLED_ShowChar(42,3,':',16);
	OLED_Show_Float_Number(52,3,temp,16);
	OLED_ShowStr(100,3,"'C",16);

	OLED_ShowCN(6,6,8);	
	OLED_ShowCN(24,6,9);
    OLED_ShowChar(42,6,':',16);
	OLED_Show_Float_Number(52,6,Humi,16);
	OLED_ShowStr(100,6,"%RH",16);	
}
#endif 